## arch/powerpc/cpu/mpc8xx/Kconfig
```kconfig
menu "mpc8xx CPU"
	depends on 8xx

config SYS_CPU
	default "mpc8xx"

choice
	prompt "Target select"
	optional

config TARGET_MCR3000
	bool "Support MCR3000 board from CSSI"

endchoice

source "board/cssi/MCR3000/Kconfig"

endmenu
```

## arch/powerpc/lib/Kconfig
```kconfig
config CMD_IMMAP
	bool "Enable various commands to dump IMMR information"
	depends on 8xx
	help
	  This enables various commands such as:

	    siuinfo - print System Interface Unit (SIU) registers
	    memcinfo - print Memory Controller registers
	    sitinfo - print System Integration Timers (SIT) registers
```

## configs/MCR3000_defconfig
```kconfig
CONFIG_PPC=y
CONFIG_8xx=y
CONFIG_TARGET_MCR3000=y
CONFIG_BOOTDELAY=5
CONFIG_HUSH_PARSER=y
# CONFIG_CMD_SETEXPR is not set
CONFIG_CMD_NET=y
CONFIG_CMD_DHCP=y
# CONFIG_LED_STATUS_BOARD_SPECIFIC is not set
# CONFIG_MMC is not set
CONFIG_MTD_NOR_FLASH=y
# CONFIG_PCI is not set
CONFIG_OF_LIBFDT=y
CONFIG_SYS_PROMPT="S3K> "

CONFIG_CMD_SAVEENV=y
CONFIG_CMD_FLASH=y
CONFIG_CMD_MII=y
CONFIG_CMD_PING=y
CONFIG_CMD_ASKENV=y
CONFIG_CMD_REGINFO=y
CONFIG_CMD_MTDPARTS=y
CONFIG_CMD_NAND=y
# CONFIG_CMD_BDI is not set
# CONFIG_CMD_ECHO is not set
# CONFIG_CMD_FPGA is not set
# CONFIG_CMD_IMI is not set
# CONFIG_CMD_IMLS is not set
# CONFIG_CMD_ITEST is not set
# CONFIG_CMD_CONSOLE is not set
# CONFIG_CMD_LOADB is not set
# CONFIG_CMD_LOADS is not set
# CONFIG_CMD_MD5SUM is not set
# CONFIG_CMD_MISC is not set
# CONFIG_CMD_SETGETDCR is not set
# CONFIG_CMD_SHA1 is not set
# CONFIG_CMD_SOURCE is not set
```
